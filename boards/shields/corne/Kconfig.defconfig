## boards/shields/corne/Kconfig.defconfig
```kconfig
if SHIELD_CORNE_DONGLE

config ZMK_KEYBOARD_NAME
    default "Corne"

config ZMK_USB
  	default y

endif

if SHIELD_CORNE_DONGLE || SHIELD_CORNE_LEFT || SHIELD_CORNE_RIGHT

config ZMK_SPLIT
    default y

endif
```

## boards/shields/corne/Kconfig.shield
```kconfig
# Copyright (c) 2020 Pete Johanson
# SPDX-License-Identifier: MIT

config SHIELD_CORNE
    bool

config SHIELD_CORNE_DONGLE
    def_bool $(shields_list_contains,corne_dongle)
    select ZMK_SPLIT_ROLE_CENTRAL
    select ZMK_SPLIT
    select SHIELD_CORNE

config SHIELD_CORNE_LEFT
    def_bool $(shields_list_contains,corne_left)
    select ZMK_SPLIT
    select SHIELD_CORNE

config SHIELD_CORNE_RIGHT
    def_bool $(shields_list_contains,corne_right)
    select ZMK_SPLIT
    select SHIELD_CORNE
```
